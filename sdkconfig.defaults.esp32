## sdkconfig.defaults.esp32
```kconfig
# ESPectre Configuration for ESP32 (Classic)
# ESP32-D0WD-V3 without PSRAM

CONFIG_IDF_TARGET="esp32"

# Wi-Fi Configuration
CONFIG_ESP_WIFI_STATIC_RX_BUFFER_NUM=8
CONFIG_ESP_WIFI_DYNAMIC_RX_BUFFER_NUM=16
CONFIG_ESP_WIFI_DYNAMIC_TX_BUFFER_NUM=16
CONFIG_ESP_WIFI_AMPDU_TX_ENABLED=y
CONFIG_ESP_WIFI_AMPDU_RX_ENABLED=y
CONFIG_ESP_WIFI_RX_BA_WIN=6

# CSI Support (CRITICAL)
CONFIG_ESP_WIFI_CSI_ENABLED=y

# MQTT Configuration
CONFIG_MQTT_PROTOCOL_311=y
CONFIG_MQTT_TRANSPORT_SSL=n
CONFIG_MQTT_TRANSPORT_WEBSOCKET=n

# FreeRTOS Configuration
CONFIG_FREERTOS_HZ=1000
CONFIG_FREERTOS_UNICORE=n

# ESP32 Specific
CONFIG_ESP32_DEFAULT_CPU_FREQ_240=y

# NO PSRAM for ESP32 classic
CONFIG_SPIRAM=n

# Memory Configuration (reduced for no PSRAM)
CONFIG_ESP_MAIN_TASK_STACK_SIZE=3072
CONFIG_ESP_SYSTEM_EVENT_TASK_STACK_SIZE=3072

# Logging Configuration
CONFIG_LOG_DEFAULT_LEVEL_INFO=y
CONFIG_LOG_MAXIMUM_LEVEL_DEBUG=y

# Partition Table
CONFIG_PARTITION_TABLE_SINGLE_APP=y

# Compiler Options
CONFIG_COMPILER_OPTIMIZATION_SIZE=y
CONFIG_COMPILER_OPTIMIZATION_ASSERTIONS_ENABLE=y

# Component Config
CONFIG_LWIP_MAX_SOCKETS=10
CONFIG_LWIP_SO_REUSE=y
CONFIG_LWIP_SO_RCVBUF=y

# Newlib
CONFIG_NEWLIB_NANO_FORMAT=y
CONFIG_LIBC_STDOUT_LINE_ENDING_LF=y
CONFIG_LIBC_STDIN_LINE_ENDING_LF=y

# Flash configuration
CONFIG_ESPTOOLPY_FLASHMODE_DIO=y
CONFIG_ESPTOOLPY_FLASHSIZE_4MB=y
CONFIG_ESPTOOLPY_FLASHSIZE="4MB"

# MQTT Config
CONFIG_MQTT_BROKER_URI="mqtt://homeassistant.local:1883"
CONFIG_MQTT_TOPIC="home/espectre/node1"
CONFIG_MQTT_USERNAME="mqtt"
CONFIG_MQTT_PASSWORD="mqtt"
```

## sdkconfig.defaults.esp32c6
```kconfig
# ESPectre Configuration for ESP32-C6
# ESP32-C6 typically without PSRAM, uses simplified CSI API

CONFIG_IDF_TARGET="esp32c6"

# Wi-Fi Configuration
CONFIG_ESP_WIFI_STATIC_RX_BUFFER_NUM=8
CONFIG_ESP_WIFI_DYNAMIC_RX_BUFFER_NUM=16
CONFIG_ESP_WIFI_DYNAMIC_TX_BUFFER_NUM=16
CONFIG_ESP_WIFI_AMPDU_TX_ENABLED=y
CONFIG_ESP_WIFI_AMPDU_RX_ENABLED=y
CONFIG_ESP_WIFI_RX_BA_WIN=6

# CSI Support (CRITICAL)
CONFIG_ESP_WIFI_CSI_ENABLED=y

# MQTT Configuration
CONFIG_MQTT_PROTOCOL_311=y
CONFIG_MQTT_TRANSPORT_SSL=n
CONFIG_MQTT_TRANSPORT_WEBSOCKET=n

# FreeRTOS Configuration
CONFIG_FREERTOS_HZ=1000

# ESP32-C6 Specific (single core RISC-V)
CONFIG_ESP32C6_DEFAULT_CPU_FREQ_160=y

# NO PSRAM for ESP32-C6
CONFIG_SPIRAM=n

# Memory Configuration (reduced for no PSRAM)
CONFIG_ESP_MAIN_TASK_STACK_SIZE=3072
CONFIG_ESP_SYSTEM_EVENT_TASK_STACK_SIZE=3072

# Logging Configuration
CONFIG_LOG_DEFAULT_LEVEL_INFO=y
CONFIG_LOG_MAXIMUM_LEVEL_DEBUG=y

# Partition Table
CONFIG_PARTITION_TABLE_SINGLE_APP=y

# Compiler Options
CONFIG_COMPILER_OPTIMIZATION_SIZE=y
CONFIG_COMPILER_OPTIMIZATION_ASSERTIONS_ENABLE=y

# Component Config
CONFIG_LWIP_MAX_SOCKETS=10
CONFIG_LWIP_SO_REUSE=y
CONFIG_LWIP_SO_RCVBUF=y

# Newlib
CONFIG_NEWLIB_NANO_FORMAT=y
CONFIG_LIBC_STDOUT_LINE_ENDING_LF=y
CONFIG_LIBC_STDIN_LINE_ENDING_LF=y

# Flash configuration
CONFIG_ESPTOOLPY_FLASHMODE_QIO=y
CONFIG_ESPTOOLPY_FLASHSIZE_4MB=y
CONFIG_ESPTOOLPY_FLASHSIZE="4MB"

# MQTT Config
CONFIG_MQTT_BROKER_URI="mqtt://homeassistant.local:1883"
CONFIG_MQTT_TOPIC="home/espectre/node1"
CONFIG_MQTT_USERNAME="mqtt"
CONFIG_MQTT_PASSWORD="mqtt"
```
